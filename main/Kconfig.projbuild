## main/Kconfig.projbuild
```kconfig
menu "Custom Configuration"
    config ESP_WIFI_CHANNEL
        int "WiFi Channel"
        range 1 13
        default 7
        help
            WiFi channel (network channel) to use.

    config ESP_MAX_STA_CONN
        int "Maximal STA connections"
        default 4
        help
            Max number of the STA connects to AP.

    #buttons config
    config PASS_BUTTON
        int "Password button pin"
        default 13
        help
            Password button pin

    config BRIGHT_BUTTON
        int "Bright button pin"
        default 17
        help
            Bright button pin

    config LEDS_BUTTON
        int "Leds button pin"
        default 16
        help
            Leds button pin

    #buzzer config
    config BUZZER
        int "Buzzer pin"
        default 18
        help
            Buzzer pin

    #leds strip config
    config LEDS_STRIP
        int "Leds strip pin"
        default 33
        help
            Leds strip pin
endmenu
```
